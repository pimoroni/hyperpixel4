/dts-v1/;
/plugin/;
/ {
    compatible = "brcm,bcm2708";

    fragment@0 {
        target = <&i2c_gpio>;
        __overlay__ {
            /* needed to avoid dtc warning */
            #address-cells = <1>;
            #size-cells = <0>;
            ft6236: ft6236@14 {
                compatible = "goodix,gt911";
                reg = <0x14>;
                interrupt-parent = <&gpio>;
                interrupts = <27 2>;
                touchscreen-size-x = <480>;
                touchscreen-size-y = <800>;
                touchscreen-x-mm = <51>;
                touchscreen-y-mm = <85>;
            };
        };
    };
    fragment@1 {
        target = <&ft6236>;
        __overlay__ {
            touchscreen-swapped-x-y;
        };
    };
    fragment@2 {
        target = <&ft6236>;
        __dormant__ {
            touchscreen-inverted-x;
        };
    };
    fragment@3 {
        target = <&ft6236>;
        __overlay__ {
            touchscreen-inverted-y;
        };
    };
    __overrides__ {
        touchscreen-inverted-x = <0>,"+2";
        touchscreen-inverted-y = <0>,"-3";
        touchscreen-swapped-x-y = <0>,"-1";
    };
};
